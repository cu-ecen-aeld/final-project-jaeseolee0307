## build/conf/bblayers.conf
```bitbake
# POKY_BBLAYERS_CONF_VERSION is increased each time build/conf/bblayers.conf
# changes incompatibly
POKY_BBLAYERS_CONF_VERSION = "2"

BBPATH = "${TOPDIR}"
BBFILES ?= ""

BBLAYERS ?= " \
  /home/jaeseo/Documents/final-project-jaeseolee0307/poky/meta \
  /home/jaeseo/Documents/final-project-jaeseolee0307/poky/meta-poky \
  /home/jaeseo/Documents/final-project-jaeseolee0307/poky/meta-yocto-bsp \
  "
```
